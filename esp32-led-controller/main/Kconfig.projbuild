## esp32-led-controller/main/Kconfig.projbuild
```kconfig
menu "Warehouse LED Controller"

    config LED_WIFI_SSID
        string "WiFi SSID"
        default "CHANGE_ME_WIFI"
        help
            WiFi network name for the ESP32 station.

    config LED_WIFI_PASSWORD
        string "WiFi Password"
        default "CHANGE_ME_PASSWORD"
        help
            WiFi password. Leave empty only for an open network.

    config LED_MQTT_BROKER_URI
        string "HiveMQ MQTT broker URI"
        default "mqtts://CHANGE_ME.s1.eu.hivemq.cloud:8883"
        help
            HiveMQ Cloud URI, usually mqtts://<cluster-host>:8883.

    config LED_MQTT_USERNAME
        string "HiveMQ username"
        default ""

    config LED_MQTT_PASSWORD
        string "HiveMQ password"
        default ""

    config LED_TOPIC
        string "LED command topic"
        default "warehouse/SHELF_A/led/command"

    config LED_GPIO_T1
        int "GPIO for shelf level T1"
        default 16

    config LED_GPIO_T2
        int "GPIO for shelf level T2"
        default 17

    config LED_GPIO_T3
        int "GPIO for shelf level T3"
        default 18

    config LED_GPIO_T4
        int "GPIO for shelf level T4"
        default 19

    config LED_DEFAULT_BLINK_MS
        int "Default blink interval in milliseconds"
        default 500

    config LED_DEFAULT_TIMEOUT_MS
        int "Default command timeout in milliseconds"
        default 120000

endmenu
```

## esp32-led-controller/sdkconfig.defaults
```kconfig
CONFIG_IDF_TARGET="esp32"

CONFIG_LED_WIFI_SSID="CHANGE_ME_WIFI"
CONFIG_LED_WIFI_PASSWORD="CHANGE_ME_PASSWORD"
CONFIG_LED_MQTT_BROKER_URI="mqtts://CHANGE_ME.s1.eu.hivemq.cloud:8883"
CONFIG_LED_MQTT_USERNAME=""
CONFIG_LED_MQTT_PASSWORD=""
CONFIG_LED_TOPIC="warehouse/SHELF_A/led/command"
CONFIG_LED_GPIO_T1=16
CONFIG_LED_GPIO_T2=17
CONFIG_LED_GPIO_T3=18
CONFIG_LED_GPIO_T4=19
CONFIG_LED_DEFAULT_BLINK_MS=500
CONFIG_LED_DEFAULT_TIMEOUT_MS=120000

CONFIG_ESP_MAIN_TASK_STACK_SIZE=6144
CONFIG_MBEDTLS_CERTIFICATE_BUNDLE=y
CONFIG_MBEDTLS_CERTIFICATE_BUNDLE_DEFAULT_FULL=y
```
